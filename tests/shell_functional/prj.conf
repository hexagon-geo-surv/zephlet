## CMakeLists.txt
```
cmake_minimum_required(VERSION 3.20.0)

get_filename_component(ZEPHLET_INFRA_ROOT "${CMAKE_CURRENT_SOURCE_DIR}/../.." ABSOLUTE)

set_property(GLOBAL PROPERTY PROTO_FILES_LIST)

# CONFIG_ZEPHLETS_SHELL=y (prj.conf) makes the infra module pull in
# frontends/shell/ automatically — nothing to wire manually here.
list(APPEND EXTRA_ZEPHYR_MODULES
    "${ZEPHLET_INFRA_ROOT}"
    "${CMAKE_CURRENT_SOURCE_DIR}/zephlets/tick"
    "${CMAKE_CURRENT_SOURCE_DIR}/zephlets/ui"
    "${CMAKE_CURRENT_SOURCE_DIR}/zephlets/typelab"
    "${CMAKE_CURRENT_SOURCE_DIR}/zephlets/quiet"
)

find_package(Zephyr REQUIRED HINTS $ENV{ZEPHYR_BASE})

project(zephlet_shell_functional_test)

list(APPEND CMAKE_MODULE_PATH ${ZEPHYR_BASE}/modules/nanopb)
include(nanopb)
set(NANOPB_OPTIONS "--c-style")

get_property(LOCAL_PROTO_FILES_LIST GLOBAL PROPERTY PROTO_FILES_LIST)

# Anchor nanopb output under tests/shell_functional/zephlets/ so each
# proto lands at ${CMAKE_BINARY_DIR}/<type>/<prefix>.pb.h, matching the
# `#include "<type>/<prefix>.pb.h"` pattern that codegen emits.
set(_saved_csd ${CMAKE_CURRENT_SOURCE_DIR})
set(CMAKE_CURRENT_SOURCE_DIR "${CMAKE_CURRENT_SOURCE_DIR}/zephlets")
zephyr_nanopb_sources(app ${LOCAL_PROTO_FILES_LIST})
set(CMAKE_CURRENT_SOURCE_DIR ${_saved_csd})

target_sources(app PRIVATE src/main.c)
```

## prj.conf
```kconfig
CONFIG_ZBUS=y
CONFIG_ZEPHLETS=y
CONFIG_ZEPHLETS_SHELL=y
CONFIG_NANOPB=y

CONFIG_ZEPHLET_TICK=y
CONFIG_ZEPHLET_UI=y
CONFIG_ZEPHLET_TYPELAB=y
CONFIG_ZEPHLET_QUIET=y

CONFIG_LOG=y
CONFIG_ASSERT=y

# Only fields wider than 32 bits need this: since v0.3.0 the printer uses
# width-correct conversions rather than promoting everything to long long.
# f_uint64/f_int64/f_fixed64/f_sfixed64 are exactly those fields, and
# report PB_TF_ERR_UNSUPPORTED without it. CBPRINTF_COMPLETE is not set
# here -- it is Zephyr's own default, and the library `depends on` it.
CONFIG_CBPRINTF_FULL_INTEGRAL=y

CONFIG_SHELL=y
# The shell's PTY UART defaults to a new pseudoterminal the pytest
# harness (piping the DUT's own stdin/stdout) can't reach; route it to
# stdin/stdout instead, same as the coap_functional connmgr case.
CONFIG_UART_NATIVE_PTY_0_ON_STDINOUT=y
# The whole command line, not just the message. Text format names every
# field it sets, so it is considerably more verbose than the positional
# form this replaced: typelab_bench's every-field `config` call runs to
# roughly 460 characters, well past the 256-byte default.
CONFIG_SHELL_CMD_BUFF_SIZE=1024
# The harness writes a command far faster than the shell drains it, and
# the serial RX ring buffer defaults to 64 bytes — a long line would be
# truncated mid-parse.
CONFIG_SHELL_BACKEND_SERIAL_RX_RING_BUFFER_SIZE=1024
# The shell wraps its echo of the command at this width, and pytest's
# Shell.exec_command() matches that echo against a *single* line — so a
# wrapped echo fails the test even when the command itself worked
# perfectly. Harmless on a real console, fatal here. Must stay above the
# longest command any test sends; typelab_bench's every-field `config`
# call is ~460 characters, so 400 was no longer enough once arguments
# became text format.
CONFIG_SHELL_DEFAULT_TERMINAL_WIDTH=1024

CONFIG_MAIN_STACK_SIZE=2048
```

## src/main.c
```c
#include <zephyr/kernel.h>
#include <zephyr/logging/log.h>

#include "zlet_quiet.h"
#include "zlet_tick.h"
#include "zlet_typelab.h"
#include "zlet_ui.h"

LOG_MODULE_REGISTER(zlet_shell_functional, LOG_LEVEL_INF);

/**
 * @file
 * @brief Host app for the shell functional twister target.
 *
 * Instantiates two `tick` instances (tick_fast, tick_slow), one `ui`
 * instance (ui_main), and one `typelab` instance (typelab_bench). Each
 * ZEPHLET_NEW(...) call registers its instance under the `zlet` shell
 * root command automatically (CONFIG_ZEPHLETS_SHELL=y, set in prj.conf)
 * via the `_ZLET_SHELL_HOOK_<type>` hook chained into
 * `_ZLET_FRONTEND_HOOKS_<type>` — no shell-specific code needed here.
 *
 * `typelab_bench` is the coverage bench, in two halves. Typelab.Config
 * carries one field (and one set_X/get_X rpc pair) per nanopb scalar
 * ltype, driven by `pytest/test_typelab_types.py`. Typelab.Shapes
 * carries every *repetition rule* — optional and repeated scalars,
 * singular/optional/repeated submessages, optional and repeated strings
 * and bytes, and three levels of nesting — driven by
 * `pytest/test_field_shapes.py` through its own set_shapes/get_shapes
 * pair. Between them every shell parse/print path is exercised through a
 * real `zlet typelab_bench ...` command, not just the couple of scalar
 * types tick/ui happen to use.
 *
 * `quiet_main` sets the `shell` option false on every rpc, so it is the
 * one instance with no `zlet` subcommand; `ui_main` hides two of its own.
 */

static struct tick_config tick_fast_cfg = {
	.duration_ms = 100,
	.period_ms = 100,
};
static struct tick_data tick_fast_data;
ZEPHLET_NEW(tick, tick_fast, &tick_fast_cfg, &tick_fast_data, tick_init_fn);

/* Second `tick` instance — exercises the no-cross-talk case between two
 * instances of the same type. */
static struct tick_config tick_slow_cfg = {
	.duration_ms = 500,
	.period_ms = 500,
};
static struct tick_data tick_slow_data;
ZEPHLET_NEW(tick, tick_slow, &tick_slow_cfg, &tick_slow_data, tick_init_fn);

static struct ui_config ui_main_cfg = {
	.blink_period_ms = 250,
};
static struct ui_data ui_main_data;
ZEPHLET_NEW(ui, ui_main, &ui_main_cfg, &ui_main_data, ui_init_fn);

static struct typelab_config typelab_bench_cfg;
static struct typelab_data typelab_bench_data;
ZEPHLET_NEW(typelab, typelab_bench, &typelab_bench_cfg, &typelab_bench_data, typelab_init_fn);

static struct quiet_config quiet_main_cfg;
static struct quiet_data quiet_main_data;
ZEPHLET_NEW(quiet, quiet_main, &quiet_main_cfg, &quiet_main_data, quiet_init_fn);

int main(void)
{
	LOG_INF("zephlet shell functional host up");
	return 0;
}
```
